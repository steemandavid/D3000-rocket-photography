## firmware/crig/main/Kconfig.projbuild
```kconfig
menu "CRIG"
    choice CRIG_UNIT
        prompt "CRIG unit"
        default CRIG_UNIT_NODE
        config CRIG_UNIT_NODE
            bool "Camera node"
        config CRIG_UNIT_REMOTE
            bool "Remote"
    endchoice
    config CRIG_TEST_HOOKS
        bool "Console test hooks (remote: sim shoot/trig/arm, badcrc)"
        default y
endmenu
```

## firmware/crig/sdkconfig.defaults
```kconfig
CONFIG_IDF_TARGET="esp32s3"
CONFIG_ESP_CONSOLE_UART_DEFAULT=y
CONFIG_ESP_CONSOLE_UART_BAUDRATE=115200
CONFIG_ESPTOOLPY_FLASHSIZE_16MB=y
CONFIG_SPIRAM=y
CONFIG_SPIRAM_MODE_OCT=y
CONFIG_FREERTOS_HZ=1000
CONFIG_ESP_WIFI_ENABLED=y
CONFIG_LOG_DEFAULT_LEVEL_INFO=y
```

## firmware/remote_hwtest/sdkconfig.defaults
```kconfig
CONFIG_IDF_TARGET="esp32s3"
CONFIG_ESP_CONSOLE_UART_DEFAULT=y
CONFIG_ESP_CONSOLE_UART_BAUDRATE=115200
CONFIG_ESPTOOLPY_FLASHSIZE_16MB=y
CONFIG_SPIRAM=y
CONFIG_SPIRAM_MODE_OCT=y
```
