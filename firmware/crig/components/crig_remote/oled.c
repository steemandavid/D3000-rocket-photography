/* SSD1306 128x64 over I2C (VMA438, 0x3C). Minimal text driver. */
#include "oled.h"
#include <string.h>
#include <ctype.h>
#include "driver/i2c_master.h"

static i2c_master_bus_handle_t s_bus;
static i2c_master_dev_handle_t s_dev;
static bool s_ok;
static uint8_t s_fb[128 * 8];

static const char FONT_CH[] = " 0123456789ABCDEFGHIJKLMNOPQRSTUVWXYZ:.-%=/~!>()";
static const uint8_t FONT[][5] = {
    {0,0,0,0,0},
    {0x3E,0x51,0x49,0x45,0x3E},{0x00,0x42,0x7F,0x40,0x00},{0x42,0x61,0x51,0x49,0x46},{0x21,0x41,0x45,0x4B,0x31},
    {0x18,0x14,0x12,0x7F,0x10},{0x27,0x45,0x45,0x45,0x39},{0x3C,0x4A,0x49,0x49,0x30},{0x01,0x71,0x09,0x05,0x03},
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    {0x00,0x41,0x22,0x14,0x08},{0x00,0x1C,0x22,0x41,0x00},{0x00,0x41,0x22,0x1C,0x00},
};

static bool cmds(const uint8_t *c, int n)
{
    uint8_t b[32] = { 0x00 };
    memcpy(b + 1, c, n);
    return i2c_master_transmit(s_dev, b, n + 1, 50) == ESP_OK;
}

bool oled_init(int sda, int scl)
{
    i2c_master_bus_config_t bc = { .i2c_port = I2C_NUM_0, .sda_io_num = sda, .scl_io_num = scl,
                                   .clk_source = I2C_CLK_SRC_DEFAULT, .glitch_ignore_cnt = 7, .flags.enable_internal_pullup = true };
    if (i2c_new_master_bus(&bc, &s_bus) != ESP_OK) return false;
    if (i2c_master_probe(s_bus, 0x3C, 50) != ESP_OK) return false;
    i2c_device_config_t dc = { .dev_addr_length = I2C_ADDR_BIT_LEN_7, .device_address = 0x3C, .scl_speed_hz = 400000 };
    if (i2c_master_bus_add_device(s_bus, &dc, &s_dev) != ESP_OK) return false;
    static const uint8_t init[] = { 0xAE, 0xD5, 0x80, 0xA8, 0x3F, 0xD3, 0x00, 0x40, 0x8D, 0x14, 0x20, 0x00,
                                    0xA1, 0xC8, 0xDA, 0x12, 0x81, 0xCF, 0xD9, 0xF1, 0xDB, 0x40, 0xA4, 0xA6, 0xAF };
    s_ok = cmds(init, sizeof init);
    return s_ok;
}

void oled_clear(void) { memset(s_fb, 0, sizeof s_fb); }

void oled_text(int col, int row, const char *s)
{
    if (row < 0 || row > 7) return;
    for (int x = col * 6; *s && x <= 122; s++, x += 6) {
        const char *p = strchr(FONT_CH, toupper((unsigned char)*s));
        memcpy(s_fb + row * 128 + x, FONT[p ? p - FONT_CH : 0], 5);
        s_fb[row * 128 + x + 5] = 0;
    }
}

void oled_flush(void)
{
    if (!s_ok) return;
    static const uint8_t win[] = { 0x21, 0, 127, 0x22, 0, 7 };
    cmds(win, sizeof win);
    static uint8_t b[129];
    for (int p = 0; p < 8; p++) {
        b[0] = 0x40;
        memcpy(b + 1, s_fb + p * 128, 128);
        i2c_master_transmit(s_dev, b, sizeof b, 50);
    }
}
